## meta-tc358743/conf/layer.conf
```bitbake
# We have a conf and classes directory, add to BBPATH
BBPATH .= ":${LAYERDIR}"

# We have recipes-* directories, add to BBFILES
BBFILES += "${LAYERDIR}/recipes-*/*/*.bb \
            ${LAYERDIR}/recipes-*/*/*.bbappend"

BBFILE_COLLECTIONS += "tc358743"
BBFILE_PATTERN_tc358743 = "^${LAYERDIR}/"
BBFILE_PRIORITY_tc358743 = "10"

LAYERDEPENDS_tc358743 = "core"
LAYERSERIES_COMPAT_tc358743 = "scarthgap"
```
